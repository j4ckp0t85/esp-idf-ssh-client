## main/Kconfig.projbuild
```kconfig
menu "Application Configuration"

	config ESP_WIFI_SSID
		string "WiFi SSID"
		default "myssid"
		help
			SSID (network name) for to connect to.

	config ESP_WIFI_PASSWORD
		string "WiFi Password"
		default "mypassword"
		help
			WiFi password (WPA or WPA2) to use.

	config ESP_MAXIMUM_RETRY
		int "Maximum retry"
		default 5
		help
			Set the Maximum retry to avoid station reconnecting to the AP unlimited when the AP is really inexistent.

	
	config SSH_USER
		string "SSH Username"
		default "ssh-user"
		help
			Username of SSH Connection.

	config SSH_PASSWORD
		string "SSH Password"
		default "ssh-pass"
		help
			Password of SSH Connection.

	config SSH_HOST
		string "SSH Host"
		default "192.168.10.10"
		help
			IP address of SSH host.
			mDMS name cannot be used.

	config SSH_PORT
		int "SSH Port"
		default 22
		help
			Port number of SSH server.

	config GPIO_OUTPUT_0
        int "GPIO output pin 0"
        default 18 if IDF_TARGET_ESP32 || IDF_TARGET_ESP32S2 || IDF_TARGET_ESP32C3 || IDF_TARGET_ESP32S3
        default 8 if IDF_TARGET_ESP32C2 || IDF_TARGET_ESP32H2
        help
            GPIO pin number to be used as GPIO_OUTPUT_IO_0.

    config GPIO_OUTPUT_1
        int "GPIO output pin 1"
        default 19 if IDF_TARGET_ESP32 || IDF_TARGET_ESP32S2 || IDF_TARGET_ESP32C3 || IDF_TARGET_ESP32S3
        default 9 if IDF_TARGET_ESP32C2 || IDF_TARGET_ESP32H2
        help
            GPIO pin number to be used as GPIO_OUTPUT_IO_1.

    config GPIO_INPUT_0
        int "GPIO input pin 0"
        default 4
        help
            GPIO pin number to be used as GPIO_INPUT_IO_0.

    config GPIO_INPUT_1
        int "GPIO input pin 1"
        default 5
        help
            GPIO pin number to be used as GPIO_INPUT_IO_1.

endmenu
```
